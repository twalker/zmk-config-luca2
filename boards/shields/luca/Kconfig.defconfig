## boards/shields/luca/Kconfig.defconfig
```kconfig
if SHIELD_LUCA_LEFT

config ZMK_KEYBOARD_NAME
    default "luca"

config ZMK_SPLIT_ROLE_CENTRAL
    default y

endif # SHIELD_LUCA_LEFT

if SHIELD_LUCA_LEFT || SHIELD_LUCA_RIGHT

config ZMK_SPLIT
    default y

endif # SHIELD_LUCA_LEFT || SHIELD_LUCA_RIGHT
```

## boards/shields/luca/Kconfig.shield
```kconfig
config SHIELD_LUCA_LEFT
    def_bool $(shields_list_contains,luca_left)

config SHIELD_LUCA_RIGHT
    def_bool $(shields_list_contains,luca_right)
```
